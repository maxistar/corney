## config/Kconfig.defconfig
```kconfig
if SHIELD_CORNEY_LEFT

config ZMK_KEYBOARD_NAME
    default "Corney"

config ZMK_SPLIT_ROLE_CENTRAL
    default y

endif # SHIELD_CORNEY_LEFT

if SHIELD_CORNEY_LEFT || SHIELD_CORNEY_RIGHT

config ZMK_SPLIT
    default y

# Enable mouse support
config ZMK_MOUSE
    default y

config ZMK_POINTING
    default y

endif # SHIELD_CORNEY_LEFT || SHIELD_CORNEY_RIGHT
```

## config/Kconfig.shield
```kconfig
config SHIELD_CORNEY_LEFT
    def_bool $(shields_list_contains,corne_left)

config SHIELD_CORNEY_RIGHT
    def_bool $(shields_list_contains,corne_right)
```

## config/boards/shields/corney/Kconfig.defconfig
```kconfig
if SHIELD_CORNE_LEFT

config ZMK_KEYBOARD_NAME
    default "Corney"

config ZMK_SPLIT_ROLE_CENTRAL
    default y

endif # SHIELD_CORNE_LEFT

if SHIELD_CORNE_LEFT || SHIELD_CORNE_RIGHT

config ZMK_SPLIT
    default y

# Enable mouse support
config ZMK_MOUSE
    default y

config ZMK_POINTING
    default y


endif # SHIELD_CORNE_LEFT || SHIELD_CORNE_RIGHT
```

## config/boards/shields/dacty/Kconfig.defconfig
```kconfig
if SHIELD_DACTY_LEFT

config ZMK_KEYBOARD_NAME
    default "Dacty"

config ZMK_SPLIT_ROLE_CENTRAL
    default y

endif # SHIELD_DACTY_LEFT

if SHIELD_DACTY_LEFT || SHIELD_DACTY_RIGHT

config ZMK_SPLIT
    default y

# Enable mouse support
config ZMK_MOUSE
    default y

config ZMK_POINTING
    default y

config ZMK_RGB_UNDERGLOW
    select WS2812_STRIP
    select SPI

if ZMK_DISPLAY

config SSD1306
    default y

config I2C
    default y

endif # ZMK_DISPLAY

if LVGL

config LV_Z_VDB_SIZE
    default 64

config LV_DPI_DEF
    default 148

config LV_Z_BITS_PER_PIXEL
    default 1

choice LV_COLOR_DEPTH
    default LV_COLOR_DEPTH_1
endchoice

endif # LVGL

endif # SHIELD_DACTY_LEFT || SHIELD_DACTY_RIGHT
```

## config/boards/shields/dacty/Kconfig.shield
```kconfig
config SHIELD_DACTY_LEFT
    def_bool $(shields_list_contains,dacty_left)

config SHIELD_DACTY_RIGHT
    def_bool $(shields_list_contains,dacty_right)
```

## config/dts/bindings/behaviors/zmk,behavior-raw-layer.yaml
```yaml
description: Raw HID layer report behavior

compatible: "zmk,behavior-raw-layer"

include: one_param.yaml
```

## config/west.yml
```yaml
manifest:
  remotes:
    - name: zmkfirmware
      url-base: https://github.com/zmkfirmware
    - name: zzeneg
      url-base: https://github.com/zzeneg      
    # Additional modules containing boards/shields/custom code can be listed here as well
    # See https://docs.zephyrproject.org/3.2.0/develop/west/manifest.html#projects
  projects:
    - name: zmk
      remote: zmkfirmware
      revision: v0.2.1
      import: app/west.yml
    - name: zmk-raw-hid
      remote: zzeneg
      revision: main      
  self:
    path: config
```

## zephyr/Kconfig
```kconfig
menuconfig ZMK_GATT_LAYER_EXPOSITION
    bool "Expose active layer number over GATT"
    depends on ZMK_BLE && BT_GATT
    help
      Adds a custom GATT service/characteristic that exposes the currently
      active layer number as a readable byte and optionally notifies on
      layer changes.
```
