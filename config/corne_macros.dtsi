// layers

#define LOWER 1
#define MAGIC 2

/ {
    macros {

        to_lower: to_lower {
          compatible = "zmk,behavior-macro";
          #binding-cells = <0>;
          bindings = <&mo LOWER>;
        };

        to_magic: to_magic {
          compatible = "zmk,behavior-macro";
          #binding-cells = <0>;
          bindings = <&mo MAGIC>;
        };
    };
};
