## Kconfig
```kconfig
menuconfig ZMK_GATT_LAYER_EXPOSITION
    bool "Expose active layer over a custom GATT characteristic"
    depends on ZMK_BLE
    depends on !ZMK_SPLIT || ZMK_SPLIT_ROLE_CENTRAL
    default y
    help
      Exposes the highest active layer as a custom BLE GATT characteristic
      that supports read, encrypted write, and notify operations.

if ZMK_GATT_LAYER_EXPOSITION

menuconfig ZMK_KEYBOARD_HELPER_EXTENSION
    bool "Enable the Keyboard Helper BLE event extension"
    depends on ZMK_SPLIT_ROLE_CENTRAL
    default n
    help
      Adds the reviewed version 1 capabilities and encrypted event-stream
      characteristics. The legacy layer register remains available when this
      option is disabled.

if ZMK_KEYBOARD_HELPER_EXTENSION

config ZMK_KEYBOARD_HELPER_KEY_EVENTS
    bool "Publish physical key events"
    default y

config ZMK_KEYBOARD_HELPER_COMBO_EVENTS
    bool "Publish firmware-resolved combo events"
    default y

config ZMK_KEYBOARD_HELPER_LAYER_EVENTS
    bool "Publish authoritative layer events"
    default y

config ZMK_KEYBOARD_HELPER_DIAGNOSTICS
    bool "Publish bounded operational diagnostics"
    default y

config ZMK_KEYBOARD_HELPER_EVENT_QUEUE_SIZE
    int "Keyboard Helper event queue entries"
    range 4 64
    default 16

config ZMK_KEYBOARD_HELPER_TEST_DROP_SECOND_SUBSCRIBER
    bool "TEST ONLY: drop alternate frames for the second subscriber"
    default n
    help
      Acceptance-only transport fault injection. Every second non-snapshot
      frame for the second subscriber is acknowledged locally without being
      sent. Release firmware configurations must leave this disabled.

endif # ZMK_KEYBOARD_HELPER_EXTENSION

endif # ZMK_GATT_LAYER_EXPOSITION

config ZMK_KEYBOARD_HELPER_COMBO_TEST_LOG
    bool "Emit Keyboard Helper combo integration-test events"
    depends on BOARD_NATIVE_POSIX
    default n
    help
      Emits deterministic combo-wrapper events for the native ZMK integration
      tests. Release firmware configurations must leave this disabled.

config ZMK_KEYBOARD_HELPER_EVENT_TEST_LOG
    bool "Emit Keyboard Helper event-source integration-test events"
    depends on BOARD_NATIVE_POSIX
    default n
    help
      Emits deterministic physical-position events for the native ZMK
      integration tests. Release firmware configurations must leave this
      disabled.

config CORNEY_INPUT_SPLIT_TEST_LOG
    bool "Emit Corney input-split integration-test events"
    depends on BOARD_NATIVE_POSIX
    depends on ZMK_INPUT_SPLIT
    depends on ZMK_SPLIT_ROLE_CENTRAL
    default n
    help
      Injects deterministic pointing events at the central split transport
      boundary and logs the proxy input events observed by native tests.
      Release firmware configurations must leave this disabled.

config CORNEY_INPUT_SPLIT_DISCONNECT_RELEASE
    bool "Release split pointing buttons when the peripheral disconnects"
    depends on ZMK_INPUT_SPLIT
    depends on ZMK_SPLIT_ROLE_CENTRAL
    default y if SHIELD_CORNEY_LEFT || SHIELD_CORNEY_DONGLE
    help
      Tracks button events independently for each central input-split proxy
      and releases retained remote buttons if a BLE split peripheral
      disconnects. This prevents a lost release packet from leaving a host
      button stuck.

config CORNEY_DONGLE_BATTERY_STATUS_SCREEN
    bool "Corney dongle hybrid battery status screen"
    depends on SHIELD_CORNEY_DONGLE
    depends on ZMK_DISPLAY
    depends on ZMK_DISPLAY_STATUS_SCREEN_CUSTOM
    depends on ZMK_SPLIT_BLE_CENTRAL_BATTERY_LEVEL_FETCHING
    default y
    help
      Composes ZMK's standard output and local battery widgets with a full-name
      active-layer row and one compact row for two anonymous split-peripheral
      battery levels on the dongle-only SSD1306. The remote values intentionally
      do not claim left/right identity.

config INPUT_CORNEY_PINNACLE_POLLING
    bool "Corney Cirque Pinnacle polling driver"
    depends on I2C
    depends on INPUT
    depends on DT_HAS_CORNEY_CIRQUE_PINNACLE_POLLING_ENABLED
    default y
    help
      Enables the I2C-only Cirque Pinnacle input driver used by the Corney
      halves. The driver polls each locally attached sensor and does not
      require a data-ready GPIO.

config INPUT_CORNEY_PINNACLE_INIT_PRIORITY
    int "Corney Cirque Pinnacle initialization priority"
    depends on INPUT_CORNEY_PINNACLE_POLLING
    default INPUT_INIT_PRIORITY
```

## config/boards/shields/corney/Kconfig.shield
```kconfig
config SHIELD_CORNEY_LEFT
    def_bool $(shields_list_contains,corney_left)

config SHIELD_CORNEY_RIGHT
    def_bool $(shields_list_contains,corney_right)

config SHIELD_CORNEY_LEFT_PERIPHERAL
    def_bool $(shields_list_contains,corney_left_peripheral)

config SHIELD_CORNEY_DONGLE
    def_bool $(shields_list_contains,corney_dongle)
```

## dts/bindings/behaviors/corney,behavior-combo-telemetry.yaml
```yaml
description: Corney combo telemetry wrapper behavior

compatible: "corney,behavior-combo-telemetry"

include: zero_param.yaml

properties:
  combo-id:
    type: int
    required: true
  key-positions:
    type: array
    required: true
  bindings:
    type: phandle-array
    required: true
```

## dts/bindings/input/corney,cirque-pinnacle-polling.yaml
```yaml
description: Cirque Pinnacle trackpad accessed by periodic I2C polling

compatible: "corney,cirque-pinnacle-polling"

include: i2c-device.yaml

properties:
  poll-interval-ms:
    type: int
    default: 8
    description: Interval between active status polls in milliseconds.

  sensitivity:
    type: string
    default: "2x"
    enum:
      - "1x"
      - "2x"
      - "3x"
      - "4x"
    description: ADC attenuation setting; 1x is most sensitive.

  primary-tap-enable:
    type: boolean
    description: Enable primary tap reports from relative packets.

  sleep-mode-enable:
    type: boolean
    description: Enable the sensor's autonomous low-power mode while idle.
```
